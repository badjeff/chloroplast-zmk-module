## boards/badjeff/chloroplast/Kconfig.chloroplast
```kconfig
# Copyright (c) 2026 The ZMK Contributors
# SPDX-License-Identifier: MIT

config BOARD_CHLOROPLAST
    select SOC_NRF52840_QIAA if BOARD_CHLOROPLAST

    select SOC_NRF52840_QIAA if BOARD_CHLOROPLAST_NRF52840_ZMK || BOARD_CHLOROPLAST_NRF52840_ZMK_DEBUG
    select ZMK_BOARD_COMPAT if BOARD_CHLOROPLAST_NRF52840_ZMK || BOARD_CHLOROPLAST_NRF52840_ZMK_DEBUG
    imply RETAINED_MEM if BOARD_CHLOROPLAST_NRF52840_ZMK || BOARD_CHLOROPLAST_NRF52840_ZMK_DEBUG
    imply RETENTION if BOARD_CHLOROPLAST_NRF52840_ZMK || BOARD_CHLOROPLAST_NRF52840_ZMK_DEBUG
    imply RETENTION_BOOT_MODE if BOARD_CHLOROPLAST_NRF52840_ZMK || BOARD_CHLOROPLAST_NRF52840_ZMK_DEBUG
```

## boards/badjeff/chloroplast/Kconfig.defconfig
```kconfig
# Electronut Labs Papyr board configuration

# Copyright (c) 2020 The ZMK Contributors
# SPDX-License-Identifier: MIT

if BOARD_CHLOROPLAST

config BOARD
    default "chloroplast"

if USB_DEVICE_STACK

config USB_NRFX
    default y

endif # USB_DEVICE_STACK

config BT_CTLR
    default BT

config CHARGER
    default y

if BT

config BT_BAS
    default y

config BT_BAS_BLS
    default y

endif # BT

endif # BOARD_CHLOROPLAST
```

## boards/badjeff/chloroplast/board.yml
```yaml
board:
  name: chloroplast
  vendor: badjeff
  socs:
    - name: nrf52840
      variants:
        - name: zmk
        - name: zmk_debug
  revision:
    format: major.minor.patch
    default: 1.0.0
    revisions:
      - name: 1.0.0
```

## boards/badjeff/chloroplast/chloroplast_1_0_0_defconfig
```kconfig
# Copyright (c) 2026 The ZMK Contributors
# SPDX-License-Identifier: MIT

# Enable MPU
CONFIG_ARM_MPU=y

CONFIG_PINCTRL=y

# enable GPIO
CONFIG_GPIO=y

# enble LED
CONFIG_LED=y
CONFIG_LED_GPIO=y

CONFIG_USE_DT_CODE_PARTITION=y
CONFIG_BUILD_OUTPUT_UF2=y

# CONFIG_CHARGER_LOG_LEVEL_DBG=y
```

## boards/badjeff/chloroplast/chloroplast_zmk_debug_1_0_0_defconfig
```kconfig
# Copyright (c) 2026 The ZMK Contributors
# SPDX-License-Identifier: MIT

# Enable MPU
CONFIG_ARM_MPU=y

CONFIG_PINCTRL=y

# enable GPIO
CONFIG_GPIO=y

# enble LED
CONFIG_LED=y
CONFIG_LED_GPIO=y

CONFIG_USE_DT_CODE_PARTITION=y
CONFIG_BUILD_OUTPUT_UF2=y

# CONFIG_CHARGER_LOG_LEVEL_DBG=y

CONFIG_MPU_ALLOW_FLASH_WRITE=y
CONFIG_NVS=y
CONFIG_SETTINGS_NVS=y
CONFIG_FLASH=y
CONFIG_FLASH_PAGE_LAYOUT=y
CONFIG_FLASH_MAP=y
CONFIG_CLOCK_CONTROL_NRF=y
CONFIG_CLOCK_CONTROL_NRF_K32SRC_RC=y

CONFIG_ZMK_USB=y
CONFIG_ZMK_BLE=y

# Enable debug specific settings
CONFIG_DEBUG=y
CONFIG_DEBUG_COREDUMP=y
CONFIG_DEBUG_THREAD_INFO=y
CONFIG_DEBUG_COREDUMP_BACKEND_FLASH_PARTITION=y
# CONFIG_DEBUG_COREDUMP_MEMORY_DUMP_THREADS=y

CONFIG_SOC_FLASH_NRF_RADIO_SYNC_NONE=y
CONFIG_SOC_FLASH_NRF_PARTIAL_ERASE=y
CONFIG_SOC_FLASH_NRF_PARTIAL_ERASE_MS=3
```

## boards/shields/chlorokun/Kconfig.shield
```kconfig
# Copyright (c) 2020 Pete Johanson
# SPDX-License-Identifier: MIT

config SHIELD_CHLOROKUN
	def_bool $(shields_list_contains,CHLOROKUN)
```

## drivers/charger/Kconfig
```kconfig
# Copyright (c) 2026 badjeff
# SPDX-License-Identifier: Apache-2.0

if CHARGER

rsource "Kconfig.bq2518x"
rsource "Kconfig.bq2518x_gpio"
rsource "Kconfig.bq25186_bas"

endif # ADC
```

## drivers/charger/Kconfig.bq25186_bas
```kconfig
# Copyright 2026 badjeff
#
# SPDX-License-Identifier: Apache-2.0

config CHARGER_BQ25186_BAS
	bool "BQ25186 Battery Charger BAS Integration"
	default y
	depends on DT_HAS_TI_BQ25186_BAS_ENABLED
	depends on BT
	depends on BT_BAS
	depends on BT_BAS_BLS
	select CHARGER_BQ2518X
	help
	  Enable BQ25186 battery charger driver BAS integration.
```

## drivers/charger/Kconfig.bq2518x
```kconfig
# Copyright 2024 Google LLC
# Copyright 2026 badjeff
#
# SPDX-License-Identifier: Apache-2.0

config CHARGER_BQ2518X
	bool "BQ2518x Battery Charger"
	default y
	depends on DT_HAS_TI_BQ25186_ENABLED
	select I2C
	help
	  Enable BQ2518x battery charger driver.

config CHARGER_BQ2518X_MODE_INT_SIG
	bool "Use Interrupt Indicator pin for signal"
	default y
```

## drivers/charger/Kconfig.bq2518x_gpio
```kconfig
# Copyright 2026 badjeff
#
# SPDX-License-Identifier: Apache-2.0

config CHARGER_BQ2518X_GPIO
	bool "BQ2518X Battery Charger PG/GPO Pin GPIO Brigde"
	default y
	depends on DT_HAS_TI_BQ2518X_GPIO_ENABLED
	depends on GPIO
	select CHARGER_BQ2518X
	help
	  Expose BQ2518X battery charger GPO Pin.
```

## dts/bindings/charger/ti,bq25186-bas.yaml
```yaml
# Copyright 2026 The ZMK Contributors
# SPDX-License-Identifier: MIT

description: |
  BQ25186 I2C Controlled Battery Charger BAS Integration.

compatible: "ti,bq25186-bas"

properties:
  charger-device:
    type: phandle
    required: true
    description: BQ25186 device to monitor
  irq-gpios:
    type: phandle-array
    required: true
    description: Data ready gpio, INT pin on BQ25186
```

## dts/bindings/charger/ti,bq2518x-gpio.yaml
```yaml
# Copyright 2026 The ZMK Contributors
# SPDX-License-Identifier: MIT

description: |
  Virtual GPIO controller child node utilizing the GPO open-drain pin 
  on the TI BQ2518x linear charger.

compatible: "ti,bq2518x-gpio"

include: [gpio-controller.yaml, base.yaml]

properties:
  gpio-controller:
    required: true

  "#gpio-cells":
    type: int
    required: true
    const: 2

gpio-cells:
  - pin
  - flags
```
