/*
 * Copyright (c) 2020 Pete Johanson
 *
 * SPDX-License-Identifier: MIT
 */

#include <dt-bindings/zmk/matrix_transform.h>
// #include <physical_layouts.dtsi>

/ {
	chosen {
		zmk,kscan = &kscan0;
		zmk,matrix-transform = &default_transform;
	};

	kscan0: kscan_0 {
		compatible = "zmk,kscan-gpio-direct";
		wakeup-source;
		input-gpios =
				// front side - left col
					<&gpio0 6 (GPIO_ACTIVE_LOW | GPIO_PULL_UP)>
				, <&gpio0 8  (GPIO_ACTIVE_LOW | GPIO_PULL_UP)>
				, <&gpio0 17 (GPIO_ACTIVE_LOW | GPIO_PULL_UP)>
				, <&gpio0 20 (GPIO_ACTIVE_LOW | GPIO_PULL_UP)>
				, <&gpio0 22 (GPIO_ACTIVE_LOW | GPIO_PULL_UP)>
				, <&gpio0 24 (GPIO_ACTIVE_LOW | GPIO_PULL_UP)>
				, <&gpio1 0  (GPIO_ACTIVE_LOW | GPIO_PULL_UP)>
				, <&gpio0 5  (GPIO_ACTIVE_LOW | GPIO_PULL_UP)>
				, <&gpio1 4  (GPIO_ACTIVE_LOW | GPIO_PULL_UP)>
				, <&gpio1 6  (GPIO_ACTIVE_LOW | GPIO_PULL_UP)>

				// front side - right col
				, <&gpio0 31 (GPIO_ACTIVE_LOW | GPIO_PULL_UP)>
				, <&gpio0 29 (GPIO_ACTIVE_LOW | GPIO_PULL_UP)>
				, <&gpio0 2  (GPIO_ACTIVE_LOW | GPIO_PULL_UP)>
				, <&gpio1 10 (GPIO_ACTIVE_LOW | GPIO_PULL_UP)>
				, <&gpio1 13 (GPIO_ACTIVE_LOW | GPIO_PULL_UP)>
				, <&gpio1 11 (GPIO_ACTIVE_LOW | GPIO_PULL_UP)>
				, <&gpio0 10 (GPIO_ACTIVE_LOW | GPIO_PULL_UP)>
				, <&gpio0 9  (GPIO_ACTIVE_LOW | GPIO_PULL_UP)>

				// back side
				, <&gpio0 4  (GPIO_ACTIVE_LOW | GPIO_PULL_UP)>
				, <&gpio0 12 (GPIO_ACTIVE_LOW | GPIO_PULL_UP)>
				, <&gpio0 28 (GPIO_ACTIVE_LOW | GPIO_PULL_UP)>
				, <&gpio0 3  (GPIO_ACTIVE_LOW | GPIO_PULL_UP)>
				, <&gpio1 2  (GPIO_ACTIVE_LOW | GPIO_PULL_UP)>
				;
	};

	default_transform: keymap_transform {
		compatible = "zmk,matrix-transform";
		columns = <1>;
		rows = <23>;
		map = 
				// front side - left col
		      < RC(0,0) >
				, < RC(1,0) >
				, < RC(2,0) >
				, < RC(3,0) >
				, < RC(4,0) >
				, < RC(5,0) >
				, < RC(6,0) >
				, < RC(7,0) >
				, < RC(8,0) >
				, < RC(9,0) >

				// front side - right col
				, < RC(10,0) >
				, < RC(11,0) >
				, < RC(12,0) >
				, < RC(13,0) >
				, < RC(14,0) >
				, < RC(15,0) >
				, < RC(16,0) >
				, < RC(17,0) >

				// back side
				, < RC(18,0) >
				, < RC(19,0) >
				, < RC(20,0) >
				, < RC(21,0) >
				, < RC(22,0) >
				;
	};

};
